#include <Arduino.h>
#include <ESP8266WiFi.h>
#include <ESP8266WebServer.h>

// --- Wi-Fi Access Point ---
const char* ssid = "ESP_Motor_WS";
const char* password = "12345678";

#define IN1 5   // D1
#define IN2 4   // D2
#define IN3 14  // D5
#define IN4 12  // D6

// The 28BYJ-48 is driven in half-step mode (8 phases per electrical cycle), which doubles the
// resolution of the old full-step drive and makes the motion visibly smoother.
#define STEPS_PER_REV 4096

#define DEFAULT_STOPS 36

// --- Motion tuning ---
const float DEFAULT_RPM = 4.0;      // speed used for scan stops and /rotate without speed args
const float MAX_RPM = 12.0;         // above this the 28BYJ-48 starts skipping steps
const float MIN_STEPS_PER_SEC = 2.0;
const float ACCEL = 600.0;          // steps/s^2, for the ramps at the start and end of every move

// Timer1 with TIM_DIV16 counts at 80 MHz / 16 = 5 MHz.
#define TICKS_PER_SEC 5000000UL
#define MAX_RAMP 1024

// --- HTTP Server ---
ESP8266WebServer server(80);

// ---------------------------------------------------------------------------
// Motion engine
//
// Steps are generated by the timer1 interrupt, so Wi-Fi and HTTP handling in loop() cannot
// introduce jitter into the step timing. Every move follows a trapezoidal speed profile: the
// interval before each step is looked up from a precomputed constant-acceleration ramp, indexed
// by how many steps have been taken or remain (whichever is smaller), so the move accelerates,
// cruises and decelerates symmetrically. Short moves become triangular automatically.
// ---------------------------------------------------------------------------

const uint32_t COIL_MASK = (1UL << IN1) | (1UL << IN2) | (1UL << IN3) | (1UL << IN4);
uint32_t phaseMask[8];               // GPIO set-mask for each half-step phase

uint32_t rampTicks[MAX_RAMP];        // rampTicks[k]: interval between step k and k+1 from rest
volatile uint32_t rampLen = 0;
volatile uint32_t cruiseTicks = 0;
float rampBuiltFor = -1;             // steps/s the ramp table was built for

volatile bool motorMoving = false;
volatile int8_t motorDir = 1;
volatile uint8_t phase = 0;
volatile uint32_t stepsDone = 0;
volatile uint32_t stepsTotal = 0;
volatile long position = 0;          // absolute position in half-steps

inline void IRAM_ATTR writeCoils(uint8_t p) {
  GPOC = COIL_MASK & ~phaseMask[p];
  GPOS = phaseMask[p];
}

void releaseCoils() {
  if (!motorMoving) GPOC = COIL_MASK;
}

void IRAM_ATTR onStepTimer() {
  phase = (phase + motorDir) & 7;
  writeCoils(phase);
  position += motorDir;
  stepsDone++;

  uint32_t remaining = stepsTotal - stepsDone;
  if (remaining == 0) {
    motorMoving = false;             // single-shot timer: not re-arming stops the motor
    return;
  }
  uint32_t k = ((stepsDone < remaining) ? stepsDone : remaining) - 1;
  timer1_write(k < rampLen ? rampTicks[k] : cruiseTicks);
}

void buildRamp(float stepsPerSec) {
  if (stepsPerSec == rampBuiltFor) return;
  uint32_t cruise = (uint32_t)(TICKS_PER_SEC / stepsPerSec);
  uint32_t n = 0;
  float tPrev = 0;
  while (n < MAX_RAMP) {
    float t = sqrtf(2.0f * (n + 1) / ACCEL);
    uint32_t ticks = (uint32_t)((t - tPrev) * TICKS_PER_SEC);
    if (ticks <= cruise) break;
    rampTicks[n++] = ticks;
    tPrev = t;
  }
  rampLen = n;
  cruiseTicks = cruise;
  rampBuiltFor = stepsPerSec;
}

float clampSpeed(float stepsPerSec) {
  const float maxSps = MAX_RPM * STEPS_PER_REV / 60.0;
  if (stepsPerSec > maxSps) return maxSps;
  if (stepsPerSec < MIN_STEPS_PER_SEC) return MIN_STEPS_PER_SEC;
  return stepsPerSec;
}

// Starts a relative move of `steps` half-steps (sign = direction) at `stepsPerSec` cruise speed.
bool startMove(long steps, float stepsPerSec) {
  if (motorMoving || steps == 0) return false;
  buildRamp(clampSpeed(stepsPerSec));

  motorDir = (steps > 0) ? 1 : -1;
  stepsTotal = (uint32_t)labs(steps);
  stepsDone = 0;
  writeCoils(phase);                 // energize the holding phase before the first step
  motorMoving = true;
  timer1_write(rampLen > 0 ? rampTicks[0] : cruiseTicks);
  return true;
}

// Decelerates along the ramp instead of stopping dead.
void softStop() {
  noInterrupts();
  if (motorMoving) {
    uint32_t remaining = stepsTotal - stepsDone;
    uint32_t k = (stepsDone < remaining) ? stepsDone : remaining;  // current ramp position
    if (k > rampLen) k = rampLen;
    if (k < 1) k = 1;
    if (k < remaining) stepsTotal = stepsDone + k;
  }
  interrupts();
}

// ---------------------------------------------------------------------------
// Jobs
// ---------------------------------------------------------------------------

enum Job { JOB_IDLE, JOB_SCAN, JOB_ROTATE };
Job job = JOB_IDLE;

// --- Scan (stop-and-go) state ---
bool waitingForContinue = false;
bool segmentInFlight = false;
int totalStops = 0;
int currentStop = 0;
long scanTotalSteps = 0;
float scanSpeed = 0;

// --- Rotation state ---
long rotationStart = 0;
long rotationSteps = 0;
float rotationSpeed = 0;

// Position of stop i relative to the scan origin. Rounding each target (rather than moving a
// truncated stepsPerStop every time) keeps the stops evenly spaced and the last one at 360°.
long stopTarget(int i) {
  return ((long)i * scanTotalSteps * 2 + totalStops) / (2L * totalStops);
}

void startNextSegment() {
  long steps = stopTarget(currentStop + 1) - stopTarget(currentStop);
  segmentInFlight = startMove(steps, scanSpeed);
}

void finishJob(const char* msg) {
  job = JOB_IDLE;
  waitingForContinue = false;
  segmentInFlight = false;
  releaseCoils();
  Serial.println(msg);
}

void processJobs() {
  if (motorMoving) return;
  if (job == JOB_IDLE) releaseCoils();   // e.g. after a /stop deceleration finishes

  if (job == JOB_SCAN && segmentInFlight) {
    segmentInFlight = false;
    currentStop++;
    waitingForContinue = true;       // app polls /status, takes the photo, then sends /continue
    Serial.printf("Reached stop %d/%d\n", currentStop, totalStops);
  } else if (job == JOB_ROTATE) {
    finishJob("Rotation complete.");
  }
}

// ---------------------------------------------------------------------------
// HTTP helpers
// ---------------------------------------------------------------------------

void sendJson(const String &json, int code = 200) {
  server.sendHeader("Access-Control-Allow-Origin", "*");
  server.sendHeader("Access-Control-Allow-Methods", "GET,POST,OPTIONS");
  server.sendHeader("Access-Control-Allow-Headers", "Content-Type");
  server.send(code, "application/json", json);
}

void sendOk(const String &msg = "OK") {
  server.sendHeader("Access-Control-Allow-Origin", "*");
  server.send(200, "text/plain", msg);
}

float rpmFromArgs() {
  float rpm = server.hasArg("rpm") ? server.arg("rpm").toFloat() : DEFAULT_RPM;
  return (rpm > 0) ? rpm : DEFAULT_RPM;
}

// Cruise speed from the optional `seconds` (duration of the whole move) or `rpm` arguments.
float speedFromArgs(long steps) {
  if (server.hasArg("seconds")) {
    float s = server.arg("seconds").toFloat();
    if (s > 0) return labs(steps) / s;
  }
  return rpmFromArgs() * STEPS_PER_REV / 60.0;
}

// ---------------------------------------------------------------------------
// HTTP Handlers
// ---------------------------------------------------------------------------

void handleStatus() {
  float progress = 0;
  if (job == JOB_ROTATE && rotationSteps != 0) {
    progress = (float)labs(position - rotationStart) / labs(rotationSteps);
  } else if (job == JOB_SCAN && totalStops > 0) {
    progress = (float)currentStop / totalStops;
  }
  const char* mode = (job == JOB_SCAN) ? "scan" : (job == JOB_ROTATE) ? "rotate" : "idle";

  String json = "{";
  json += "\"running\":" + String(job != JOB_IDLE ? "true" : "false") + ",";
  json += "\"mode\":\"" + String(mode) + "\",";
  json += "\"moving\":" + String(motorMoving ? "true" : "false") + ",";
  json += "\"waitingForContinue\":" + String(waitingForContinue ? "true" : "false") + ",";
  json += "\"currentStop\":" + String(currentStop) + ",";
  json += "\"totalStops\":" + String(totalStops) + ",";
  json += "\"position\":" + String(position) + ",";
  json += "\"progress\":" + String(progress, 3) + "}";
  sendJson(json);
}

// POST /start?turns=<n>[&rpm=<r>] - stop-and-go scan with DEFAULT_STOPS stops.
void handleStart() {
  if (job != JOB_IDLE || motorMoving) {
    server.send(409, "text/plain", "Busy");
    return;
  }
  int turns = 0;
  if (server.hasArg("turns")) turns = server.arg("turns").toInt();
  if (turns <= 0) {
    server.send(400, "text/plain", "Invalid args. Use POST /start?turns=<n>");
    return;
  }

  // Always use DEFAULT_STOPS stops; ignore any stops parameter from client
  totalStops = DEFAULT_STOPS;
  currentStop = 0;
  scanTotalSteps = (long)STEPS_PER_REV * turns;
  scanSpeed = rpmFromArgs() * STEPS_PER_REV / 60.0;
  waitingForContinue = false;
  job = JOB_SCAN;
  Serial.printf("START %d turns, %d stops\n", turns, totalStops);
  sendOk("STARTED");
  startNextSegment();
}

void handleContinue() {
  if (job != JOB_SCAN || !waitingForContinue) {
    server.send(409, "text/plain", "Not waiting for continue");
    return;
  }
  waitingForContinue = false;
  sendOk("CONTINUING");
  if (currentStop < totalStops) {
    startNextSegment();
  } else {
    finishJob("Sequence complete.");
  }
}

// POST /stop - decelerates smoothly and cancels the current job.
void handleStop() {
  softStop();
  job = JOB_IDLE;
  waitingForContinue = false;
  segmentInFlight = false;
  Serial.println("Manual stop triggered.");
  sendOk("STOPPED");
}

// POST /rotate?turns=<n>[&rpm=<r> | &seconds=<s>] - one continuous, smooth move.
// A negative `turns` rotates the other way. `seconds` is the cruise time for the whole move;
// the accel/decel ramps add a fraction of a second on top.
void handleRotate() {
  if (job != JOB_IDLE || motorMoving) {
    server.send(409, "text/plain", "Already running");
    return;
  }
  float turns = 1;
  if (server.hasArg("turns")) turns = server.arg("turns").toFloat();
  long steps = lroundf(turns * STEPS_PER_REV);
  if (steps == 0) {
    server.send(400, "text/plain", "Invalid turns. Use POST /rotate?turns=<n>[&rpm=<r>|&seconds=<s>]");
    return;
  }

  rotationSpeed = clampSpeed(speedFromArgs(steps));
  rotationStart = position;
  rotationSteps = steps;
  job = JOB_ROTATE;
  startMove(steps, rotationSpeed);

  Serial.printf("ROTATE %.2f turns (%ld steps) at %.1f steps/s\n", turns, steps, rotationSpeed);
  sendJson("{\"steps\":" + String(steps) +
           ",\"stepsPerSec\":" + String(rotationSpeed, 2) +
           ",\"seconds\":" + String(labs(steps) / rotationSpeed, 2) + "}");
}

void setup() {
  Serial.begin(115200);

  // Half-step sequence: IN1, IN1+IN2, IN2, IN2+IN3, IN3, IN3+IN4, IN4, IN4+IN1
  const uint8_t pins[4] = {IN1, IN2, IN3, IN4};
  for (int p = 0; p < 8; p++) {
    uint32_t m = 1UL << pins[p / 2];
    if (p % 2) m |= 1UL << pins[(p / 2 + 1) % 4];
    phaseMask[p] = m;
  }
  for (int i = 0; i < 4; i++) {
    pinMode(pins[i], OUTPUT);
    digitalWrite(pins[i], LOW);
  }

  timer1_attachInterrupt(onStepTimer);
  timer1_enable(TIM_DIV16, TIM_EDGE, TIM_SINGLE);

  // Start Wi-Fi Access Point
  WiFi.mode(WIFI_AP);
  WiFi.softAP(ssid, password);
  IPAddress IP = WiFi.softAPIP();
  Serial.println();
  Serial.print("Access Point: "); Serial.println(ssid);
  Serial.print("Password: "); Serial.println(password);
  Serial.print("Connect via HTTP: http://"); Serial.print(IP); Serial.println("/");

  // Start HTTP server
  server.on("/status", HTTP_GET, handleStatus);
  server.on("/start", HTTP_POST, handleStart);
  server.on("/rotate", HTTP_POST, handleRotate);
  server.on("/continue", HTTP_POST, handleContinue);
  server.on("/stop", HTTP_POST, handleStop);
  server.onNotFound([](){ server.send(404, "text/plain", "Not Found"); });
  server.begin();
  Serial.println("HTTP server started!");
}

void loop() {
  server.handleClient();
  processJobs();
}
